## buildroot/package/thor-gpu-firmware/Config.in
```kconfig
config BR2_PACKAGE_THOR_GPU_FIRMWARE
	bool "thor-gpu-firmware"
	help
	  The Adreno 740's firmware for the AYN Thor: its microcode
	  (qcom/a740_sqe.fw), its power controller's
	  (qcom/gmu_gen70200.bin) and the zap shader
	  (qcom/sm8550/a740_zap.mbn), from the linux-firmware release
	  ROCKNIX builds with. Buildroot's linux-firmware is older and
	  has none of the three: without them the GPU doesn't start.

	  https://git.kernel.org/pub/scm/linux/kernel/git/firmware/linux-firmware.git
```

## buildroot/package/vita3k/Config.in
```kconfig
config BR2_PACKAGE_VITA3K
	bool "vita3k"
	depends on BR2_aarch64 || BR2_x86_64
	depends on BR2_INSTALL_LIBSTDCPP
	depends on BR2_TOOLCHAIN_USES_GLIBC
	depends on BR2_TOOLCHAIN_GCC_AT_LEAST_13 # C++20
	depends on BR2_PACKAGE_HAS_LIBEGL && BR2_PACKAGE_HAS_LIBGLES
	select BR2_PACKAGE_LIBEVDEV
	select BR2_PACKAGE_OPENSSL
	select BR2_PACKAGE_ZLIB
	select BR2_PACKAGE_DBUS
	select BR2_PACKAGE_ALSA_LIB
	select BR2_PACKAGE_WAYLAND
	select BR2_PACKAGE_LIBXKBCOMMON
	select BR2_PACKAGE_VULKAN_HEADERS
	help
	  Vita3K, the PlayStation Vita emulator (Vulkan, on Wayland).
	  The Vita's firmware and the games come from the user.
	  Launcher: /usr/libexec/banana/run-vita3k.

	  https://vita3k.org
```

## buildroot/package/wvkbd/Config.in
```kconfig
config BR2_PACKAGE_WVKBD
	bool "wvkbd"
	depends on BR2_PACKAGE_WAYLAND
	select BR2_PACKAGE_CAIRO
	select BR2_PACKAGE_PANGO
	select BR2_PACKAGE_LIBXKBCOMMON
	select BR2_PACKAGE_WAYLAND_PROTOCOLS
	help
	  An on-screen keyboard for wlroots compositors
	  (wvkbd-mobintl). BananaOS's web browser has it on the AYN
	  Thor's bottom screen (usr/libexec/banana/run-wayland
	  --keyboard); the menu's own pages have the menu's keyboard.

	  https://github.com/jjsullivan5196/wvkbd
```

## buildroot/package/xemu/Config.in
```kconfig
config BR2_PACKAGE_XEMU
	bool "xemu"
	depends on BR2_INSTALL_LIBSTDCPP
	depends on BR2_TOOLCHAIN_USES_GLIBC
	depends on BR2_USE_WCHAR # libglib2
	depends on BR2_USE_MMU # libglib2
	depends on BR2_TOOLCHAIN_HAS_THREADS
	depends on BR2_PACKAGE_HAS_LIBGBM && BR2_PACKAGE_HAS_LIBEGL && BR2_PACKAGE_HAS_LIBGLES
	depends on BR2_PACKAGE_HAS_LIBGL # links -lGL, draws with desktop OpenGL (a 4.0 core context)
	select BR2_PACKAGE_LIBGLIB2
	select BR2_PACKAGE_PIXMAN
	select BR2_PACKAGE_ZLIB
	select BR2_PACKAGE_SDL3
	select BR2_PACKAGE_LIBEPOXY
	select BR2_PACKAGE_LIBSAMPLERATE
	select BR2_PACKAGE_LIBPCAP
	select BR2_PACKAGE_SLIRP
	select BR2_PACKAGE_OPENSSL
	select BR2_PACKAGE_ALSA_LIB
	select BR2_PACKAGE_VULKAN_HEADERS
	select BR2_PACKAGE_VULKAN_LOADER
	help
	  xemu, the original Xbox emulator (SDL 3, Vulkan, on Wayland).
	  The Xbox BIOS, EEPROM and hard disk image come from the
	  user. Launcher: /usr/libexec/banana/run-xemu. Needs desktop
	  OpenGL beside Vulkan, which a GLES-only image (the AYN
	  Thor's) doesn't have.

	  https://xemu.app
```
