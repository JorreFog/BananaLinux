## buildroot/package/libretro-beetle-vb/Config.in
```kconfig
config BR2_PACKAGE_LIBRETRO_BEETLE_VB
	bool "libretro-beetle-vb"
	depends on BR2_INSTALL_LIBSTDCPP
	help
	  Virtual Boy: Mednafen's VB (Beetle VB).

	  https://github.com/libretro/beetle-vb-libretro
```

## buildroot/package/libretro-beetle-wswan/Config.in
```kconfig
config BR2_PACKAGE_LIBRETRO_BEETLE_WSWAN
	bool "libretro-beetle-wswan"
	depends on BR2_INSTALL_LIBSTDCPP
	help
	  WonderSwan (Color): Beetle Cygne.

	  https://github.com/libretro/beetle-wswan-libretro
```

## buildroot/package/libretro-bluemsx/Config.in
```kconfig
config BR2_PACKAGE_LIBRETRO_BLUEMSX
	bool "libretro-bluemsx"
	depends on BR2_INSTALL_LIBSTDCPP
	help
	  MSX, MSX2 (and ColecoVision): blueMSX (its Machines and
	  Databases folders in /data/bios).

	  https://github.com/libretro/blueMSX-libretro
```

## buildroot/package/libretro-cap32/Config.in
```kconfig
config BR2_PACKAGE_LIBRETRO_CAP32
	bool "libretro-cap32"
	depends on BR2_INSTALL_LIBSTDCPP
	help
	  Amstrad CPC: Caprice32.

	  https://github.com/libretro/libretro-cap32
```

## buildroot/package/libretro-crocods/Config.in
```kconfig
config BR2_PACKAGE_LIBRETRO_CROCODS
	bool "libretro-crocods"
	depends on BR2_INSTALL_LIBSTDCPP
	help
	  Amstrad CPC: CrocoDS.

	  https://github.com/libretro/libretro-crocods
```

## buildroot/package/libretro-dosbox-pure/Config.in
```kconfig
config BR2_PACKAGE_LIBRETRO_DOSBOX_PURE
	bool "libretro-dosbox-pure"
	depends on BR2_INSTALL_LIBSTDCPP
	help
	  DOS: DOSBox Pure (games as .zip or folders; its own on-screen
	  keyboard).

	  https://github.com/schellingb/dosbox-pure
```

## buildroot/package/libretro-fbneo/Config.in
```kconfig
config BR2_PACKAGE_LIBRETRO_FBNEO
	bool "libretro-fbneo"
	depends on BR2_INSTALL_LIBSTDCPP
	help
	  Arcade and Neo Geo: FinalBurn Neo (romsets of its own version;
	  neogeo.zip beside the games or in /data/bios).

	  https://github.com/libretro/FBNeo
```

## buildroot/package/libretro-flycast/Config.in
```kconfig
config BR2_PACKAGE_LIBRETRO_FLYCAST
	bool "libretro-flycast"
	depends on BR2_INSTALL_LIBSTDCPP
	depends on BR2_PACKAGE_HAS_LIBGLES
	select BR2_PACKAGE_ZLIB
	help
	  Dreamcast, Naomi and Atomiswave: Flycast as a libretro core
	  (GLES).

	  https://github.com/flyinghead/flycast
```

## buildroot/package/libretro-freeintv/Config.in
```kconfig
config BR2_PACKAGE_LIBRETRO_FREEINTV
	bool "libretro-freeintv"
	depends on BR2_INSTALL_LIBSTDCPP
	help
	  Intellivision: FreeIntv (exec.bin and grom.bin in /data/bios).

	  https://github.com/libretro/FreeIntv
```

## buildroot/package/libretro-gearcoleco/Config.in
```kconfig
config BR2_PACKAGE_LIBRETRO_GEARCOLECO
	bool "libretro-gearcoleco"
	depends on BR2_INSTALL_LIBSTDCPP
	help
	  ColecoVision: Gearcoleco (colecovision.rom in /data/bios).

	  https://github.com/drhelius/Gearcoleco
```

## buildroot/package/libretro-genesis-plus-gx/Config.in
```kconfig
config BR2_PACKAGE_LIBRETRO_GENESIS_PLUS_GX
	bool "libretro-genesis-plus-gx"
	depends on BR2_INSTALL_LIBSTDCPP
	help
	  Master System, Mega Drive, Mega CD and Game Gear: Genesis Plus
	  GX.

	  https://github.com/libretro/Genesis-Plus-GX
```

## buildroot/package/libretro-handy/Config.in
```kconfig
config BR2_PACKAGE_LIBRETRO_HANDY
	bool "libretro-handy"
	depends on BR2_INSTALL_LIBSTDCPP
	help
	  Atari Lynx: Handy (lynxboot.img in /data/bios).

	  https://github.com/libretro/libretro-handy
```

## buildroot/package/libretro-mame2003-plus/Config.in
```kconfig
config BR2_PACKAGE_LIBRETRO_MAME2003_PLUS
	bool "libretro-mame2003-plus"
	depends on BR2_INSTALL_LIBSTDCPP
	help
	  Arcade: MAME 2003-Plus (MAME 0.78 romsets).

	  https://github.com/libretro/mame2003-plus-libretro
```

## buildroot/package/libretro-neocd/Config.in
```kconfig
config BR2_PACKAGE_LIBRETRO_NEOCD
	bool "libretro-neocd"
	depends on BR2_INSTALL_LIBSTDCPP
	select BR2_PACKAGE_FLAC
	select BR2_PACKAGE_LIBOGG
	select BR2_PACKAGE_LIBVORBIS
	help
	  Neo Geo CD: NeoCD (neocd/ BIOS files in /data/bios).

	  https://github.com/libretro/neocd_libretro
```

## buildroot/package/libretro-nestopia/Config.in
```kconfig
config BR2_PACKAGE_LIBRETRO_NESTOPIA
	bool "libretro-nestopia"
	depends on BR2_INSTALL_LIBSTDCPP
	help
	  NES and Famicom: Nestopia UE, the accurate one (FDS too).

	  https://github.com/libretro/nestopia
```

## buildroot/package/libretro-o2em/Config.in
```kconfig
config BR2_PACKAGE_LIBRETRO_O2EM
	bool "libretro-o2em"
	depends on BR2_INSTALL_LIBSTDCPP
	help
	  Odyssey2 / Videopac: O2EM (o2rom.bin in /data/bios).

	  https://github.com/libretro/libretro-o2em
```

## buildroot/package/libretro-opera/Config.in
```kconfig
config BR2_PACKAGE_LIBRETRO_OPERA
	bool "libretro-opera"
	depends on BR2_INSTALL_LIBSTDCPP
	help
	  3DO: Opera (panafz10.bin or another 3DO BIOS in /data/bios).

	  https://github.com/libretro/opera-libretro
```

## buildroot/package/libretro-parallel-n64/Config.in
```kconfig
config BR2_PACKAGE_LIBRETRO_PARALLEL_N64
	bool "libretro-parallel-n64"
	depends on BR2_INSTALL_LIBSTDCPP
	help
	  Nintendo 64: ParaLLEl N64 (GLideN64/Glide64 on GLES; no Vulkan
	  RDP in RetroArch here).

	  https://github.com/libretro/parallel-n64
```

## buildroot/package/libretro-pokemini/Config.in
```kconfig
config BR2_PACKAGE_LIBRETRO_POKEMINI
	bool "libretro-pokemini"
	depends on BR2_INSTALL_LIBSTDCPP
	help
	  Pokemon mini: PokeMini (its free BIOS built in; bios.min from
	  the card if there).

	  https://github.com/libretro/pokemini
```

## buildroot/package/libretro-ppsspp/Config.in
```kconfig
config BR2_PACKAGE_LIBRETRO_PPSSPP
	bool "libretro-ppsspp"
	depends on BR2_INSTALL_LIBSTDCPP
	depends on BR2_PACKAGE_HAS_LIBGLES
	help
	  PSP: PPSSPP as a libretro core (GLES), v1.20.4.

	  https://github.com/hrydgard/ppsspp
```

## buildroot/package/libretro-prosystem/Config.in
```kconfig
config BR2_PACKAGE_LIBRETRO_PROSYSTEM
	bool "libretro-prosystem"
	depends on BR2_INSTALL_LIBSTDCPP
	help
	  Atari 7800: ProSystem.

	  https://github.com/libretro/prosystem-libretro
```

## buildroot/package/libretro-puae2021/Config.in
```kconfig
config BR2_PACKAGE_LIBRETRO_PUAE2021
	bool "libretro-puae2021"
	depends on BR2_INSTALL_LIBSTDCPP
	help
	  Amiga: PUAE 2021 (Kickstart ROMs in /data/bios; its own AROS
	  without them).

	  https://github.com/libretro/libretro-uae
```

## buildroot/package/libretro-px68k/Config.in
```kconfig
config BR2_PACKAGE_LIBRETRO_PX68K
	bool "libretro-px68k"
	depends on BR2_INSTALL_LIBSTDCPP
	help
	  Sharp X68000: PX68k (keropi/iplrom.dat and cgrom.dat in
	  /data/bios).

	  https://github.com/libretro/px68k-libretro
```

## buildroot/package/libretro-same-cdi/Config.in
```kconfig
config BR2_PACKAGE_LIBRETRO_SAME_CDI
	bool "libretro-same-cdi"
	depends on BR2_INSTALL_LIBSTDCPP
	help
	  Philips CD-i: SAME_CDI (MAME's CD-i driver); the CD-i BIOS
	  (cdimono1.zip) in /data/bios.

	  https://github.com/libretro/same_cdi
```

## buildroot/package/libretro-stella/Config.in
```kconfig
config BR2_PACKAGE_LIBRETRO_STELLA
	bool "libretro-stella"
	depends on BR2_INSTALL_LIBSTDCPP
	help
	  Atari 2600: Stella.

	  https://github.com/stella-emu/stella
```
