## buildroot/package/libretro-swanstation/Config.in
```kconfig
config BR2_PACKAGE_LIBRETRO_SWANSTATION
	bool "libretro-swanstation"
	depends on BR2_INSTALL_LIBSTDCPP
	depends on BR2_PACKAGE_HAS_LIBGLES
	help
	  PlayStation: SwanStation (DuckStation's libretro fork from
	  before DuckStation's no-redistribution licence).

	  https://github.com/libretro/swanstation
```

## buildroot/package/libretro-vecx/Config.in
```kconfig
config BR2_PACKAGE_LIBRETRO_VECX
	bool "libretro-vecx"
	depends on BR2_INSTALL_LIBSTDCPP
	help
	  Vectrex: vecx (its vectors drawn with GLES).

	  https://github.com/libretro/libretro-vecx
```

## buildroot/package/libretro-virtualjaguar/Config.in
```kconfig
config BR2_PACKAGE_LIBRETRO_VIRTUALJAGUAR
	bool "libretro-virtualjaguar"
	depends on BR2_INSTALL_LIBSTDCPP
	help
	  Atari Jaguar: Virtual Jaguar (incomplete: many games have
	  faults).

	  https://github.com/libretro/virtualjaguar-libretro
```

## buildroot/package/libretro-yabasanshiro/Config.in
```kconfig
config BR2_PACKAGE_LIBRETRO_YABASANSHIRO
	bool "libretro-yabasanshiro"
	depends on BR2_INSTALL_LIBSTDCPP
	depends on BR2_PACKAGE_HAS_LIBGLES && BR2_PACKAGE_HAS_LIBEGL
	help
	  Sega Saturn: YabaSanshiro, the fast one (GLES, aarch64
	  dynarec).

	  https://github.com/libretro/yabause
```

## buildroot/package/libsmb2/Config.in
```kconfig
config BR2_PACKAGE_LIBSMB2
	bool "libsmb2"
	depends on BR2_TOOLCHAIN_HAS_THREADS
	help
	  A client library for SMB2 and SMB3 in userspace (no kernel module, no Samba): the shares of a NAS or a
	  computer for Files' servers (banana-fetch). https://github.com/sahlberg/libsmb2
```

## buildroot/package/mame-gnw/Config.in
```kconfig
config BR2_PACKAGE_MAME_GNW
	bool "mame-gnw"
	default y
	depends on BR2_INSTALL_LIBSTDCPP
	depends on BR2_TOOLCHAIN_GCC_AT_LEAST_10
	select BR2_PACKAGE_SDL2
	select BR2_PACKAGE_SDL2_TTF
	help
	  MAME built with only its Sharp SM5xx LCD handheld driver (hh_sm510: every Nintendo Game & Watch, and other
	  makers' LCD games on the same chips), for the Game & Watch system. The games' ROM zips and artwork zips come
	  from the user. Patched for the RG DS's two panels (patches/mame-gnw).

	  https://www.mamedev.org
```

## buildroot/package/mesa3d-panfrost/Config.in
```kconfig
config BR2_PACKAGE_MESA3D_PANFROST
	bool "mesa3d-panfrost"
	depends on !BR2_PACKAGE_MESA3D
	depends on BR2_INSTALL_LIBSTDCPP
	depends on !BR2_STATIC_LIBS
	depends on BR2_TOOLCHAIN_HAS_SYNC_1
	depends on BR2_TOOLCHAIN_HAS_THREADS_NPTL
	depends on BR2_TOOLCHAIN_GCC_AT_LEAST_8
	select BR2_PACKAGE_LIBDRM
	select BR2_PACKAGE_ZLIB
	select BR2_PACKAGE_HAS_LIBEGL
	select BR2_PACKAGE_HAS_LIBGLES
	select BR2_PACKAGE_HAS_LIBGBM
	select BR2_PACKAGE_LIBGBM_HAS_FEATURE_FORMAT_MODIFIER_PLANE_COUNT
	select BR2_PACKAGE_LIBGBM_HAS_FEATURE_DMA_BUF
	help
	  Mesa with the Panfrost driver alone (the RK3566's Mali-G52), EGL on DRM, OpenGL ES and GBM: the GPU for
	  SuperDrastic's shaders and RetroArch. Mesa 25.0 is the last release whose Panfrost needs no LLVM and no
	  OpenCL C compiler, which Buildroot's mesa3d would build for the host and put on the target.

if BR2_PACKAGE_MESA3D_PANFROST

config BR2_PACKAGE_PROVIDES_LIBEGL
	default "mesa3d-panfrost"

config BR2_PACKAGE_PROVIDES_LIBGLES
	default "mesa3d-panfrost"

config BR2_PACKAGE_PROVIDES_LIBGBM
	default "mesa3d-panfrost"

endif
```

## buildroot/package/openabl/Config.in
```kconfig
config BR2_PACKAGE_OPENABL
	bool "openabl"
	depends on BR2_aarch64
	help
	  OpenABL, an open replacement for the Qualcomm Android bootloader (ABL) of the AYN Thor and other SM8550
	  handhelds: it starts a Linux kernel's EFI stub from the SD card. The build only copies the release's
	  signed image for SM8550 to the boot partition's openabl/ folder; it is flashed once, by hand, from Android
	  or fastboot (board/thor/openabl-README.txt). The release ROCKNIX pins.

	  https://github.com/OpenHandheldCollective/OpenABL
```

## buildroot/package/plutosvg/Config.in
```kconfig
config BR2_PACKAGE_PLUTOSVG
	bool "plutosvg"
	select BR2_PACKAGE_PLUTOVG
	select BR2_PACKAGE_FREETYPE
	help
	  A tiny SVG renderer with FreeType colour-font support.

	  https://github.com/sammycage/plutosvg
```

## buildroot/package/plutovg/Config.in
```kconfig
config BR2_PACKAGE_PLUTOVG
	bool "plutovg"
	help
	  A tiny 2D vector graphics library (plutosvg's renderer).

	  https://github.com/sammycage/plutovg
```

## buildroot/package/pocket-native/Config.in
```kconfig
config BR2_PACKAGE_POCKET_NATIVE
	bool "pocket-native"
	depends on BR2_PACKAGE_HOST_RUSTC_TARGET_ARCH_SUPPORTS
	select BR2_PACKAGE_HOST_RUSTC
	help
	  Nintendo 3DS games recompiled for the handheld, instead of emulated
	  while you play: a PC turns each game's code into a native program
	  ahead of time, and the handheld runs that plus the parts of an
	  emulator the game still needs — the system services, its GPU redone
	  in OpenGL ES, sound, and a frontend for a handheld with no desktop
	  (KMS for the screens, evdev for the buttons, ALSA for the sound).

	  A fork of Zakuro and 3dsrecomp by fearkov, which adds the OpenGL ES
	  renderer for Mali GPUs with no Vulkan driver and the handheld
	  frontend Banana needs. The games are not part of this or any image:
	  each player builds their own on a PC and copies it to the card.

	  https://github.com/whovian64/pocket-native

comment "pocket-native needs a toolchain with Rust"
	depends on !BR2_PACKAGE_HOST_RUSTC_TARGET_ARCH_SUPPORTS
```

## buildroot/package/portmaster/Config.in
```kconfig
config BR2_PACKAGE_PORTMASTER
	bool "portmaster"
	default y
	depends on BR2_PACKAGE_PYTHON3 && BR2_PACKAGE_BASH
	select BR2_PACKAGE_SDL2_TTF
	select BR2_PACKAGE_SDL2_IMAGE
	help
	  PortMaster (portmaster.games): installs and runs ports, games made for handhelds. Its release is kept in the
	  image and put on the card (roms/ports/PortMaster) the first time Ports' PortMaster entry starts; it updates
	  itself there.
```

## buildroot/package/ppsspp/Config.in
```kconfig
config BR2_PACKAGE_PPSSPP
	bool "ppsspp"
	depends on BR2_INSTALL_LIBSTDCPP
	depends on BR2_TOOLCHAIN_GCC_AT_LEAST_13 # C++20
	depends on BR2_PACKAGE_HAS_LIBEGL && BR2_PACKAGE_HAS_LIBGLES
	select BR2_PACKAGE_SDL2
	select BR2_PACKAGE_SDL2_WAYLAND
	select BR2_PACKAGE_LIBZIP
	select BR2_PACKAGE_ZLIB
	select BR2_PACKAGE_VULKAN_HEADERS
	select BR2_PACKAGE_WAYLAND
	help
	  PPSSPP, the PSP emulator (SDL 2 on Wayland, Vulkan), at
	  ROCKNIX's SM8550 commit and patches. Launcher:
	  /usr/libexec/banana/run-ppsspp.

	  https://www.ppsspp.org
```

## buildroot/package/retroarch/Config.in
```kconfig
config BR2_PACKAGE_RETROARCH
	bool "retroarch"
	depends on BR2_INSTALL_LIBSTDCPP
	depends on BR2_TOOLCHAIN_HAS_THREADS
	depends on BR2_PACKAGE_HAS_LIBEGL && BR2_PACKAGE_HAS_LIBGLES && BR2_PACKAGE_HAS_LIBGBM
	select BR2_PACKAGE_ALSA_LIB
	select BR2_PACKAGE_LIBDRM
	select BR2_PACKAGE_FREETYPE
	select BR2_PACKAGE_ZLIB
	select BR2_PACKAGE_XZ
	select BR2_PACKAGE_LIBUDEV_ZERO
	help
	  RetroArch, for the systems other than the DS: on one panel through KMS and GLES (no compositor), ALSA,
	  udev input (libudev-zero), and its RGUI menu, whose pixel look fits the menu's.

if BR2_PACKAGE_RETROARCH
source "$BR2_EXTERNAL_BANANA_PATH/package/retroarch/cores.in"
endif
```

## buildroot/package/rocknix-extra-firmware/Config.in
```kconfig
config BR2_PACKAGE_ROCKNIX_EXTRA_FIRMWARE
	bool "rocknix-extra-firmware"
	help
	  The RG DS Plus's speaker amplifiers' configuration (aw88166_acf.bin): the AW88166 driver keeps the amplifiers
	  off until it has loaded it. From ROCKNIX's extra-firmware, at the commit ROCKNIX pins.
	  On the AYN Thor: its audio and compute DSPs' firmware, the amplifiers' tuning, the sound topology and the
	  WCN7850's Wi-Fi files (ROCKNIX's SM8550 folder).
```

## buildroot/package/rocknixds-bank/Config.in
```kconfig
config BR2_PACKAGE_ROCKNIXDS_BANK
	bool "rocknixds-bank"
	default y
	depends on BR2_aarch64
	select BR2_PACKAGE_SDL2
	help
	  ROCKNIXDS Bank & Trade: a Pokémon bank, PKHeX's legality checks and Wi-Fi trading, on its own tile on the
	  shelf. ROCKNIXDS's own self-contained .NET build (no .NET runtime needed), on both panels through Banana's
	  SDL patch (SDL_BANANA_PANELS).
```

## buildroot/package/scummvm/Config.in
```kconfig
config BR2_PACKAGE_SCUMMVM
	bool "scummvm"
	depends on BR2_INSTALL_LIBSTDCPP
	depends on !BR2_STATIC_LIBS
	select BR2_PACKAGE_SDL2
	select BR2_PACKAGE_SDL2_WAYLAND if BR2_PACKAGE_SDL2_OPENGLES && BR2_PACKAGE_WAYLAND
	select BR2_PACKAGE_SDL2_NET
	select BR2_PACKAGE_FREETYPE
	select BR2_PACKAGE_ZLIB
	select BR2_PACKAGE_LIBPNG
	select BR2_PACKAGE_JPEG
	select BR2_PACKAGE_LIBOGG
	select BR2_PACKAGE_LIBVORBIS
	select BR2_PACKAGE_FLAC
	select BR2_PACKAGE_LIBMAD
	help
	  ScummVM (SDL 2), for the adventure games it supports.
	  Launcher: /usr/libexec/banana/run-scummvm.

	  https://www.scummvm.org
```

## buildroot/package/sdl3/Config.in
```kconfig
config BR2_PACKAGE_SDL3
	bool "sdl3"
	depends on !BR2_STATIC_LIBS
	depends on BR2_PACKAGE_HAS_LIBGBM && BR2_PACKAGE_HAS_LIBEGL && BR2_PACKAGE_HAS_LIBGLES
	depends on BR2_TOOLCHAIN_HAS_THREADS
	select BR2_PACKAGE_ALSA_LIB
	select BR2_PACKAGE_LIBDRM
	select BR2_PACKAGE_WAYLAND
	select BR2_PACKAGE_WAYLAND_PROTOCOLS
	select BR2_PACKAGE_LIBXKBCOMMON
	select BR2_PACKAGE_VULKAN_HEADERS
	help
	  Simple DirectMedia Layer 3: KMS/DRM, Wayland, GLES, Vulkan and
	  ALSA, for the emulators that need SDL 3 (ARMSX2).

	  https://www.libsdl.org
```

## buildroot/package/sevenzip/Config.in
```kconfig
config BR2_PACKAGE_SEVENZIP
	bool "sevenzip"
	depends on BR2_aarch64	# its makefile for arm64, as Banana's handhelds are
	depends on BR2_INSTALL_LIBSTDCPP
	depends on BR2_TOOLCHAIN_HAS_THREADS
	help
	  7-Zip's own command line, 7zz (Igor Pavlov's, built from its source), with the RAR codecs Buildroot's
	  p7zip doesn't have: the 7z and RAR archives (and encrypted zips) Files unpacks
	  (banana-fetch). https://www.7-zip.org
```

## buildroot/package/shaderc/Config.in
```kconfig
config BR2_PACKAGE_SHADERC
	bool "shaderc"
	depends on BR2_INSTALL_LIBSTDCPP
	depends on BR2_TOOLCHAIN_HAS_THREADS
	help
	  GLSL to SPIR-V compiler library, with the glslang and
	  SPIRV-Tools it is made with (ARMSX2's Vulkan renderer).

	  https://github.com/google/shaderc
```

## buildroot/package/superdrastic/Config.in
```kconfig
config BR2_PACKAGE_SUPERDRASTIC
	bool "superdrastic"
	depends on BR2_TOOLCHAIN_USES_GLIBC
	select BR2_PACKAGE_LIBDRM
	select BR2_PACKAGE_ALSA_LIB
	select BR2_PACKAGE_LIBCURL
	select BR2_PACKAGE_ZLIB
	help
	  SuperDrastic: DraStic straight onto both panels, with frame pacing, shaders, touch, the microphone,
	  RetroAchievements and its own CPU governor (github.com/JorreFog/SuperDrastic).
```

## buildroot/package/sway-lite/Config.in
```kconfig
config BR2_PACKAGE_SWAY_LITE
	bool "sway-lite"
	depends on !BR2_PACKAGE_SWAY
	depends on !BR2_STATIC_LIBS # wlroots
	depends on BR2_TOOLCHAIN_HAS_THREADS # pango, wlroots
	depends on BR2_PACKAGE_HAS_LIBEGL # wlroots
	depends on BR2_PACKAGE_HAS_LIBGLES # wlroots
	depends on BR2_PACKAGE_HAS_LIBGBM # wlroots
	depends on BR2_PACKAGE_HAS_UDEV # wlroots
	depends on BR2_TOOLCHAIN_HAS_SYNC_4 # json-c, pango
	depends on BR2_USE_WCHAR # pango
	depends on BR2_USE_MMU # pango
	depends on BR2_INSTALL_LIBSTDCPP # pango
	select BR2_PACKAGE_WLROOTS
	select BR2_PACKAGE_JSON_C
	select BR2_PACKAGE_PCRE2
	select BR2_PACKAGE_CAIRO
	select BR2_PACKAGE_CAIRO_PNG
	select BR2_PACKAGE_PANGO
	select BR2_PACKAGE_XKEYBOARD_CONFIG # runtime
	help
	  sway (the wlroots compositor) with no bar, tray, nag or
	  wallpaper program, and so with no sd-bus: Buildroot's own
	  sway package asks for systemd for its bar's tray alone.

	  BananaOS on the AYN Thor starts it only around a program
	  that draws through Wayland (usr/libexec/banana/run-wayland:
	  the standalone emulators, the browser, Wine), on both panels,
	  and it is gone when that program ends.

	  https://github.com/swaywm/sway
```
