## buildroot/Config.in
```kconfig
menu "Banana"
source "$BR2_EXTERNAL_BANANA_PATH/package/banana-ui/Config.in"
source "$BR2_EXTERNAL_BANANA_PATH/package/bananad/Config.in"
source "$BR2_EXTERNAL_BANANA_PATH/package/portmaster/Config.in"
source "$BR2_EXTERNAL_BANANA_PATH/package/libudev-zero/Config.in"
source "$BR2_EXTERNAL_BANANA_PATH/package/retroarch/Config.in"
endmenu
```

## buildroot/package/alsa-ucm-conf/Config.in
```kconfig
config BR2_PACKAGE_ALSA_UCM_CONF
	bool "alsa-ucm-conf"
	help
	  ALSA Use Case Manager configuration (and topologies): the ucm2 tree, which an opener that speaks UCM
	  (alsaucm, PipeWire's ACP) reads to set a card's routing and levels. The AYN Thor's AudioReach card
	  needs it: its profile is ROCKNIX's (patches/alsa-ucm-conf). From Banana Pocket (the Retroid Pocket
	  Classic's BananaOS), which uses it the same way.
	  https://www.alsa-project.org/
```

## buildroot/package/armsx2/Config.in
```kconfig
config BR2_PACKAGE_ARMSX2
	bool "armsx2"
	depends on BR2_aarch64
	depends on BR2_INSTALL_LIBSTDCPP
	depends on BR2_TOOLCHAIN_USES_GLIBC
	depends on BR2_TOOLCHAIN_GCC_AT_LEAST_13 # C++20
	depends on BR2_PACKAGE_HAS_LIBGBM && BR2_PACKAGE_HAS_LIBEGL && BR2_PACKAGE_HAS_LIBGLES
	select BR2_PACKAGE_SDL3
	select BR2_PACKAGE_LIBPNG
	select BR2_PACKAGE_JPEG
	select BR2_PACKAGE_ZLIB
	select BR2_PACKAGE_ZSTD
	select BR2_PACKAGE_LZ4
	select BR2_PACKAGE_WEBP
	select BR2_PACKAGE_FREETYPE
	select BR2_PACKAGE_FONTCONFIG
	select BR2_PACKAGE_PLUTOSVG
	select BR2_PACKAGE_LIBCURL
	select BR2_PACKAGE_LIBPCAP
	select BR2_PACKAGE_SHADERC
	select BR2_PACKAGE_DBUS
	select BR2_PACKAGE_EXTRA_CMAKE_MODULES
	select BR2_PACKAGE_WAYLAND
	select BR2_PACKAGE_VULKAN_HEADERS
	help
	  ARMSX2, the PlayStation 2 emulator with ARM64 recompilers
	  (a PCSX2 fork), with its SDL 3 front end (no Qt).
	  Launcher: /usr/libexec/banana/run-armsx2.

	  https://github.com/ARMSX2/ARMSX2
```

## buildroot/package/azahar/Config.in
```kconfig
config BR2_PACKAGE_AZAHAR
	bool "azahar"
	depends on BR2_aarch64 || BR2_x86_64
	depends on BR2_INSTALL_LIBSTDCPP
	depends on BR2_TOOLCHAIN_USES_GLIBC
	depends on BR2_TOOLCHAIN_GCC_AT_LEAST_13 # C++20
	depends on BR2_PACKAGE_QT6
	depends on BR2_PACKAGE_HAS_LIBEGL && BR2_PACKAGE_HAS_LIBGLES
	select BR2_PACKAGE_QT6BASE_GUI
	select BR2_PACKAGE_QT6BASE_WIDGETS
	select BR2_PACKAGE_QT6BASE_OPENGL
	select BR2_PACKAGE_QT6BASE_CONCURRENT
	select BR2_PACKAGE_QT6BASE_DBUS
	select BR2_PACKAGE_QT6BASE_NETWORK
	select BR2_PACKAGE_QT6MULTIMEDIA
	select BR2_PACKAGE_QT6WAYLAND
	select BR2_PACKAGE_VULKAN_HEADERS
	select BR2_PACKAGE_ALSA_LIB
	select BR2_PACKAGE_LIBUSB
	select BR2_PACKAGE_ZSTD
	select BR2_PACKAGE_FFMPEG
	help
	  Azahar, the Nintendo 3DS emulator (Qt 6 on Wayland, Vulkan),
	  the two screens on the two panels. Launcher:
	  /usr/libexec/banana/run-azahar.

	  https://azahar-emu.org
```

## buildroot/package/bananad/Config.in
```kconfig
config BR2_PACKAGE_BANANAD
	bool "bananad"
	help
	  Banana's power daemon: sleep (power button, lid, idle), shutdown, volume and brightness keys, battery guard.
```

## buildroot/package/bananads/Config.in
```kconfig
config BR2_PACKAGE_BANANADS
	bool "bananads"
	depends on BR2_TOOLCHAIN_USES_GLIBC
	depends on BR2_INSTALL_LIBSTDCPP
	select BR2_PACKAGE_LIBDRM
	select BR2_PACKAGE_ALSA_LIB
	select BR2_PACKAGE_ZLIB
	help
	  BananaDS, the Nintendo DS emulator on melonDS's core, with SuperDrastic's display path, governor and sound
	  (github.com/JorreFog/SuperDrastic, bananads/). Its launcher is /usr/libexec/banana/run-bananads
	  (docs/EMULATORS.md says what it is given and what is expected of it); Settings > Nintendo DS > Emulator
	  switches the DS shelf to it.
```

## buildroot/package/bananafront/Config.in
```kconfig
config BR2_PACKAGE_BANANAFRONT
	bool "bananafront"
	depends on BR2_TOOLCHAIN_USES_GLIBC
	select BR2_PACKAGE_LIBDRM
	select BR2_PACKAGE_ALSA_LIB
	select BR2_PACKAGE_ZLIB
	help
	  BananaFront, BananaOS's own frontend for the libretro cores (what RetroArch ran): KMS on the game panel,
	  ALSA at 48 kHz, the saves and states RetroArch keeps, the in-game menu, RetroAchievements, the companion
	  export. Launcher: /usr/libexec/banana/run-bananafront; Settings > Other systems > Frontend.
```

## buildroot/package/bananatube/Config.in
```kconfig
config BR2_PACKAGE_BANANATUBE
	bool "bananatube"
	depends on BR2_TOOLCHAIN_USES_GLIBC
	depends on BR2_INSTALL_LIBSTDCPP
	select BR2_PACKAGE_LIBDRM
	select BR2_PACKAGE_MESA3D_PANFROST
	select BR2_PACKAGE_LIBCURL
	select BR2_PACKAGE_CJSON
	select BR2_PACKAGE_JPEG
	select BR2_PACKAGE_FREETYPE
	select BR2_PACKAGE_ZLIB
	select BR2_PACKAGE_MPV
	help
	  BananaTube: a native dual-screen YouTube client. The content (search, results and video) is on the
	  top panel, the controls (keyboard, transport and details) are on the bottom touch panel, and there is
	  no browser, web view, compositor or yt-dlp. It takes DRM master the way BananaDS does and is started by
	  /usr/libexec/banana/run-bananatube.

	  libmpv renders the video into the top panel's EGL surface, with the demuxer cache capped at 16 MiB
	  and mpv's own yt-dlp switched off: its defaults assume a desktop's memory.
```

## buildroot/package/box64/Config.in
```kconfig
config BR2_PACKAGE_BOX64
	bool "box64"
	depends on BR2_aarch64
	depends on BR2_TOOLCHAIN_USES_GLIBC
	select BR2_PACKAGE_NCURSES # libtinfo.so.6 for box64-bash
	help
	  Runs x86_64 Linux programs on ARM64 with a dynamic
	  recompiler, handing their calls into system libraries
	  (Vulkan, Wayland, ALSA, SDL) to the ARM64 ones. BananaOS's
	  PC games on the AYN Thor: Wine's x86_64 build runs under it
	  (usr/libexec/banana/pc-games), with its 32-bit side (Box32)
	  for Windows programs that are 32-bit.

	  https://github.com/ptitSeb/box64
```

## buildroot/package/dodakvarter/Config.in
```kconfig
config BR2_PACKAGE_DODAKVARTER
	bool "dodakvarter"
	default y
	select BR2_PACKAGE_LIBDRM
	help
	  Döda Kvarter, ROCKNIXDS's zombie roguelike made for both screens (the top the game, the bottom the
	  inventory), on its own tile on the shelf. It draws straight to the panels (KMS) and loads ALSA at run time.
```

## buildroot/package/dolphin/Config.in
```kconfig
config BR2_PACKAGE_DOLPHIN
	bool "dolphin"
	depends on BR2_INSTALL_LIBSTDCPP
	depends on BR2_TOOLCHAIN_USES_GLIBC
	depends on BR2_TOOLCHAIN_GCC_AT_LEAST_13 # C++20
	depends on BR2_PACKAGE_HAS_LIBEGL && BR2_PACKAGE_HAS_LIBGLES
	select BR2_PACKAGE_LIBEVDEV
	select BR2_PACKAGE_LIBDRM
	select BR2_PACKAGE_ZLIB
	select BR2_PACKAGE_LIBPNG
	select BR2_PACKAGE_LZO
	select BR2_PACKAGE_LIBUSB
	select BR2_PACKAGE_ZSTD
	select BR2_PACKAGE_ALSA_LIB
	select BR2_PACKAGE_LIBCURL
	select BR2_PACKAGE_WAYLAND
	select BR2_PACKAGE_WAYLAND_PROTOCOLS
	select BR2_PACKAGE_LIBXKBCOMMON
	select BR2_PACKAGE_VULKAN_HEADERS
	select BR2_PACKAGE_VULKAN_LOADER
	help
	  Dolphin, the GameCube and Wii emulator (its nogui player, on
	  Wayland with Vulkan), at ROCKNIX's SM8550 commit and patches.
	  Launcher: /usr/libexec/banana/run-dolphin.

	  https://dolphin-emu.org
```

## buildroot/package/drastic/Config.in
```kconfig
config BR2_PACKAGE_DRASTIC
	bool "drastic"
	depends on BR2_TOOLCHAIN_USES_GLIBC
	select BR2_PACKAGE_SDL2
	help
	  DraStic, the Nintendo DS emulator by Exophase (proprietary freeware), the Linux aarch64 build that ROCKNIX
	  packages. Installed to /usr/share/drastic; run-drastic copies it to the data partition on first use.
```

## buildroot/package/extra-cmake-modules/Config.in
```kconfig
config BR2_PACKAGE_EXTRA_CMAKE_MODULES
	bool "extra-cmake-modules"
	help
	  KDE's extra CMake modules (build time only), without Qt 5.

	  https://invent.kde.org/frameworks/extra-cmake-modules
```

## buildroot/package/flycast/Config.in
```kconfig
config BR2_PACKAGE_FLYCAST
	bool "flycast"
	depends on BR2_INSTALL_LIBSTDCPP
	depends on BR2_TOOLCHAIN_GCC_AT_LEAST_13 # C++20
	depends on BR2_PACKAGE_HAS_LIBEGL && BR2_PACKAGE_HAS_LIBGLES
	select BR2_PACKAGE_SDL2
	select BR2_PACKAGE_SDL2_WAYLAND
	select BR2_PACKAGE_LIBZIP
	select BR2_PACKAGE_LIBCURL
	select BR2_PACKAGE_LIBMINIUPNPC
	select BR2_PACKAGE_LUA
	select BR2_PACKAGE_ALSA_LIB
	select BR2_PACKAGE_VULKAN_HEADERS
	help
	  Flycast, the Dreamcast, Naomi and Atomiswave emulator
	  (standalone, SDL 2 on Wayland, Vulkan). Launcher:
	  /usr/libexec/banana/run-flycast.

	  https://github.com/flyinghead/flycast
```

## buildroot/package/ldacbt/Config.in
```kconfig
config BR2_PACKAGE_LDACBT
	bool "ldacbt"
	help
	  Sony's LDAC Bluetooth audio encoder (AOSP's libldac) with its
	  adaptive bit rate library, as a standalone build: what
	  bluez-alsa's --enable-ldac links against.

	  https://github.com/EHfive/ldacBT
```

## buildroot/package/libretro-a5200/Config.in
```kconfig
config BR2_PACKAGE_LIBRETRO_A5200
	bool "libretro-a5200"
	depends on BR2_INSTALL_LIBSTDCPP
	help
	  Atari 5200: a5200 (5200.rom in /data/bios, or its own free
	  BIOS).

	  https://github.com/libretro/a5200
```

## buildroot/package/libretro-beetle-ngp/Config.in
```kconfig
config BR2_PACKAGE_LIBRETRO_BEETLE_NGP
	bool "libretro-beetle-ngp"
	depends on BR2_INSTALL_LIBSTDCPP
	help
	  Neo Geo Pocket (Color): Beetle NeoPop.

	  https://github.com/libretro/beetle-ngp-libretro
```

## buildroot/package/libretro-beetle-pce-fast/Config.in
```kconfig
config BR2_PACKAGE_LIBRETRO_BEETLE_PCE_FAST
	bool "libretro-beetle-pce-fast"
	depends on BR2_INSTALL_LIBSTDCPP
	help
	  PC Engine / TurboGrafx-16 and its CD: Beetle PCE FAST
	  (syscard3.pce in /data/bios for CD games).

	  https://github.com/libretro/beetle-pce-fast-libretro
```

## buildroot/package/libretro-beetle-pcfx/Config.in
```kconfig
config BR2_PACKAGE_LIBRETRO_BEETLE_PCFX
	bool "libretro-beetle-pcfx"
	depends on BR2_INSTALL_LIBSTDCPP
	help
	  PC-FX: Beetle PC-FX (pcfx.rom in /data/bios).

	  https://github.com/libretro/beetle-pcfx-libretro
```

## buildroot/package/libretro-beetle-psx/Config.in
```kconfig
config BR2_PACKAGE_LIBRETRO_BEETLE_PSX
	bool "libretro-beetle-psx"
	depends on BR2_INSTALL_LIBSTDCPP
	help
	  PlayStation: Beetle PSX (Mednafen), software renderer.

	  https://github.com/libretro/beetle-psx-libretro
```

## buildroot/package/libretro-beetle-saturn/Config.in
```kconfig
config BR2_PACKAGE_LIBRETRO_BEETLE_SATURN
	bool "libretro-beetle-saturn"
	depends on BR2_INSTALL_LIBSTDCPP
	help
	  Sega Saturn: Beetle Saturn (Mednafen), accurate and heavy; the
	  Saturn BIOS in /data/bios.

	  https://github.com/libretro/beetle-saturn-libretro
```
